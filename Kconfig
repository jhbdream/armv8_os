## Kconfig
```kconfig
mainmenu "EEos Configuration"

menu "Compile-time checks and compiler options"

config DEBUG_INFO
	bool "Debug information"
    default y
	help
	  A kernel debug info option other than "None" has been selected
	  in the "Debug information" choice below, indicating that debug
	  information will be generated for build targets.

endmenu # "Compiler options"
```
