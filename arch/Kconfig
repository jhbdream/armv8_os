## arch/Kconfig
```kconfig
choice
	prompt "Architecture select"
	default ARCH_ARM64

config ARCH_ARM64
	bool "ARM64"

config ARCH_AARCH64
	bool "AARCH64"

config ARCH_RISCV64
	bool "RISCV64"

config ARCH_RISCV32
	bool "RISCV32"
endchoice


source "arch/arm64/Kconfig"
source "arch/aarch64/Kconfig"
source "arch/riscv64/Kconfig"
source "arch/riscv32/Kconfig"
```

## arch/aarch64/Kconfig
```kconfig
menu "ARM architecture"
    depends on ARCH_AARCH64

config 64BIT
	def_bool y

choice
    prompt "Physical address space size"
    default ARM64_PA_BITS_48
    help
      Choose the maximum physical address range that the kernel will
      support.

    config ARM64_PA_BITS_48
        bool "48-bit"
endchoice

config ARM64_PA_BITS
    int
    default 48 if ARM64_PA_BITS_48

choice
    prompt "Page size"
    default ARM64_4K_PAGES
    help
      Page size (translation granule) configuration.

config ARM64_4K_PAGES
    bool "4KB"
    help
      This feature enables 4KB pages support.

endchoice

choice
    prompt "Virtual address space size"
    default ARM64_VA_BITS_48
    help
      Allows choosing one of multiple possible virtual address
      space sizes. The level of translation table is determined by
      a combination of page size and virtual address space size.

config ARM64_VA_BITS_48
    bool "48-bit"
    depends on ARM64_4K_PAGES

endchoice

config ARM64_VA_BITS
    int
    default 39 if ARM64_VA_BITS_39
    default 48 if ARM64_VA_BITS_48

config PGTABLE_LEVELS
    int
    default 3 if ARM64_4K_PAGES && ARM64_VA_BITS_39
    default 4 if ARM64_4K_PAGES && ARM64_VA_BITS_48

endmenu
```

## arch/arm64/Kconfig
```kconfig
menu "ARM architecture"
    depends on ARCH_ARM64

config 64BIT
	def_bool y

endmenu
```

## arch/riscv32/Kconfig
```kconfig
menu "RISCV32 architecture"
    depends on ARCH_RISCV32

config 32BIT
	def_bool y

endmenu
```

## arch/riscv64/Kconfig
```kconfig
menu "RISCV64 architecture"
    depends on ARCH_RISCV64

config 64BIT
	def_bool y

endmenu
```

## driver/Kconfig
```kconfig
menu "Device Drivers"

source "driver/interrupt/Kconfig"
source "driver/console/Kconfig"
source "driver/of/Kconfig"

endmenu
```

## driver/console/Kconfig
```kconfig
menu "Console"

config CONSOLE_NAME
    string "Console name"
    default "qemu"

endmenu
```

## driver/interrupt/Kconfig
```kconfig
menu "IRQ chip support"

config ARM_GIC
    bool "ARM_GIC"
    depends on ARCH_AARCH64

config PLIC
    bool "PLIC IRQ CONTROLLER"
    depends on ARCH_RISCV64

endmenu
```

## driver/of/Kconfig
```kconfig
menu "Device Tree"

config FLAT_TEST
    bool "Enable of flat test"

config DEFAULT_DEVICE_TREE 
    depends on FLAT_TEST
    string "device tree file(arch/xxx/dts/xxx)"
    default "qemu"

endmenu
```
